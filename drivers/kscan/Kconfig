## drivers/kscan/Kconfig
```kconfig
if KSCAN

config ZMK_KSCAN_EC_MATRIX
    bool "EC Matrix KScan Driver"
    depends on DT_HAS_ZMK_KSCAN_EC_MATRIX_ENABLED
    default y

if ZMK_KSCAN_EC_MATRIX

config ZMK_KSCAN_EC_MATRIX_SHELL
	bool "EC Matrix Shell"
	default y
	depends on SHELL

config ZMK_KSCAN_EC_MATRIX_SETTINGS
	bool "EC Matrix Settings Storage"
	default y
	depends on SETTINGS

config ZMK_KSCAN_EC_MATRIX_SETTINGS_DISCRETE
	bool "Store individual calibration entries as disrete settings"
	depends on ZMK_KSCAN_EC_MATRIX_SETTINGS

config ZMK_KSCAN_EC_MATRIX_DYNAMIC_POLL_RATE
	bool "Dynamic poll rate for power savings"

config ZMK_KSCAN_EC_MATRIX_FAKE_OPEN_DRAIN
	bool "Simulate open-drain config with input/output"

config ZMK_KSCAN_EC_MATRIX_SCAN_RATE_CALC
	bool "EC Matrix scan rate calculation"
	default n
	depends on ZMK_KSCAN_EC_MATRIX
	select TIMING_FUNCTIONS

config ZMK_KSCAN_EC_MATRIX_READ_TIMING
	bool "EC Matrix read timing detail capture"
	default n
	depends on ZMK_KSCAN_EC_MATRIX
	select TIMING_FUNCTIONS

config ZMK_KSCAN_EC_MATRIX_SETTINGS_INIT_LOAD
	bool "EC Matrix Settings auto load on start"
	default y
	depends on ZMK_KSCAN_EC_MATRIX_SETTINGS

config ZMK_KSCAN_EC_MATRIX_THREAD_PRIORITY
	int "Thread priority"
	default -1
	help
	  Priority of thread used by the driver to handle interrupts.

config ZMK_KSCAN_EC_MATRIX_THREAD_STACK_SIZE
	int "Thread stack size"
	default 768
	help
	  Stack size of thread used by the driver to handle interrupts.

config ZMK_KSCAN_EC_MATRIX_CALIBRATOR
	bool "Build in the calibrator needed for initial setup of the matrix"

if ZMK_KSCAN_EC_MATRIX_CALIBRATOR

config ZMK_KSCAN_EC_MATRIX_VERBOSE_CALIBRATOR
	bool "Verbose Calibration"

endif

endif

endif
```

## dts/bindings/gpio/zmk,gpio-mux.yaml
```yaml
#
# Copyright (c) 2022 The ZMK Contributors
#
# SPDX-License-Identifier: MIT
#

description: >
  This is a representation of a multiplexer/mux

compatible: "zmk,gpio-mux"

include: [gpio-controller.yaml]

properties:
  select-gpios:
    type: phandle-array
    required: true

  en-gpios:
    type: phandle-array
    required: true
  
  out-gpios:
    type: phandle-array
  
  "#gpio-cells":
    const: 2

gpio-cells:
  - pin
  - flags
```

## dts/bindings/kscan/zmk,kscan-ec-matrix.yaml
```yaml
# Copyright (c) 2020, The ZMK Contributors
# SPDX-License-Identifier: MIT

description: GPIO keyboard demux controller

compatible: "zmk,kscan-ec-matrix"

include: [kscan.yaml, pinctrl-device.yaml]

properties:
  skip-startup-calibration:
    type: boolean
  active-polling-interval-ms:
    type: int
    default: 1
  idle-polling-interval-ms:
    type: int
    default: 50
  sleep-polling-interval-ms:
    type: int
    default: 200
  dynamic-polling-interval:
    type: boolean
  idle-after-secs:
    type: int
    default: 5
  sleep-after-secs:
    type: int
    default: 300
  matrix-warm-up-us:
    type: int
  matrix-relax-us:
    type: int
  adc-read-settle-us:
    type: int
  power-gpios:
    type: phandle-array
  input-gpios:
    type: phandle-array
    required: true
  strobe-gpios:
    type: phandle-array
    required: true
  strobe-input-masks:
    type: array
    description: Array of masked inputs for each strobe line. Those set bits are indexes of inputs to skip for each strobe line.
  drain-gpios:
    type: phandle-array
  io-channels:
    required: true
  precalib-avg-lows:
    type: array
    description: Pre-seeded avg low calibration values
  precalib-avg-highs:
    type: array
    description: Pre-seeded avg high calibration values
  
  pinctrl-0:
    required: false
  pinctrl-names:
    required: false
```
